/*
  Celestial Electric Mobile Power Trailer Monitor
  Board: Arduino UNO R4 WiFi or compatible Arduino board

  Purpose:
  Low-voltage monitoring demo for Celestial Electric's mobile power trailer.
  Monitors temperature, humidity, water/leak status, and door/contact status.
  This sketch prints values to the Serial Monitor for bench testing.

  Trailer power context:
  - Two Duracell 12V lead-acid batteries, 810 CCA each, wired in parallel.
  - Parallel wiring keeps the bank at 12V nominal.
  - EcoFlow system is treated as a separate mobile power system.
  - Battery voltage/EcoFlow integration is planned for a later version using
    proper protected interfaces.

  Safety:
  This sketch is for low-voltage monitoring, training, and demonstration only.
  Do not connect an Arduino directly to service equipment, PV circuits, battery
  terminals, inverter terminals, generator controls, transfer switches, utility
  equipment, fire alarm circuits, or any line-voltage wiring.

  Recommended Arduino Cloud variable names:
    temperatureF       float, read-only
    humidityPercent   float, read-only
    waterDetected     boolean, read-only
    doorOpen          boolean, read-only
    systemAlert       boolean, read-only

  Notes:
  - For Arduino Cloud, create the Thing/variables in Arduino Cloud first.
  - Then copy this sensor logic into the Cloud sketch generated by Arduino.
*/

#include <Wire.h>
#include <Adafruit_Sensor.h>
#include <Adafruit_BME280.h>

// -------- Pin assignments --------
const int DOOR_CONTACT_PIN = 2;   // Magnetic contact input, wired to GND when closed
const int WATER_SENSOR_PIN = 3;   // Digital output from water/leak sensor
const int GREEN_LED_PIN    = 5;   // Normal status LED through 220 ohm resistor
const int RED_LED_PIN      = 6;   // Alert status LED through 220 ohm resistor

// Adjust this if your water sensor output is inverted.
// Many digital water sensor modules output HIGH when water is detected.
const int WATER_DETECTED_STATE = HIGH;

// Alert thresholds for demonstration.
const float HIGH_TEMP_F_THRESHOLD = 95.0;
const float HIGH_HUMIDITY_THRESHOLD = 70.0;

Adafruit_BME280 bme;
bool bmeReady = false;

void setup() {
  Serial.begin(115200);
  delay(1000);

  pinMode(DOOR_CONTACT_PIN, INPUT_PULLUP);
  pinMode(WATER_SENSOR_PIN, INPUT);
  pinMode(GREEN_LED_PIN, OUTPUT);
  pinMode(RED_LED_PIN, OUTPUT);

  digitalWrite(GREEN_LED_PIN, LOW);
  digitalWrite(RED_LED_PIN, LOW);

  Serial.println("Celestial Electric Mobile Power Trailer Monitor");
  Serial.println("Low-voltage monitoring demo starting...");

  // Try common BME280 I2C addresses.
  if (bme.begin(0x76)) {
    bmeReady = true;
    Serial.println("BME280 found at address 0x76.");
  } else if (bme.begin(0x77)) {
    bmeReady = true;
    Serial.println("BME280 found at address 0x77.");
  } else {
    bmeReady = false;
    Serial.println("BME280 not found. Check wiring, power, and I2C address.");
  }
}

void loop() {
  float temperatureF = 0.0;
  float humidityPercent = 0.0;

  if (bmeReady) {
    float temperatureC = bme.readTemperature();
    temperatureF = (temperatureC * 9.0 / 5.0) + 32.0;
    humidityPercent = bme.readHumidity();
  }

  // With INPUT_PULLUP and a contact wired to GND when closed:
  // LOW = closed, HIGH = open.
  bool doorOpen = (digitalRead(DOOR_CONTACT_PIN) == HIGH);
  bool waterDetected = (digitalRead(WATER_SENSOR_PIN) == WATER_DETECTED_STATE);

  bool highTemp = bmeReady && (temperatureF >= HIGH_TEMP_F_THRESHOLD);
  bool highHumidity = bmeReady && (humidityPercent >= HIGH_HUMIDITY_THRESHOLD);

  bool systemAlert = waterDetected || doorOpen || highTemp || highHumidity || !bmeReady;

  digitalWrite(GREEN_LED_PIN, systemAlert ? LOW : HIGH);
  digitalWrite(RED_LED_PIN, systemAlert ? HIGH : LOW);

  Serial.println("----------------------------------------");
  if (bmeReady) {
    Serial.print("Temperature: ");
    Serial.print(temperatureF, 1);
    Serial.println(" °F");

    Serial.print("Humidity: ");
    Serial.print(humidityPercent, 1);
    Serial.println(" %");
  } else {
    Serial.println("Temperature/Humidity: sensor not detected");
  }

  Serial.print("Door/contact status: ");
  Serial.println(doorOpen ? "OPEN" : "CLOSED");

  Serial.print("Water leak status: ");
  Serial.println(waterDetected ? "WATER DETECTED" : "DRY");

  Serial.print("System status: ");
  Serial.println(systemAlert ? "ALERT" : "NORMAL");

  delay(2000);
}
